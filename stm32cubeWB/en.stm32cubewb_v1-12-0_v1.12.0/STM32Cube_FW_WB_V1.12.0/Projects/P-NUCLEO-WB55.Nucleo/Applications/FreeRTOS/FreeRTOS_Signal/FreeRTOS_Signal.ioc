# file: FreeRTOS_Signal.ioc
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FREERTOS.HEAP_NUMBER=4
FREERTOS.INCLUDE_eTaskGetState=1
FREERTOS.INCLUDE_pcTaskGetTaskName=0
FREERTOS.INCLUDE_uxTaskGetStackHighWaterMark=0
FREERTOS.INCLUDE_uxTaskPriorityGet=1
FREERTOS.INCLUDE_vTaskCleanUpResources=1
FREERTOS.INCLUDE_vTaskDelay=1
FREERTOS.INCLUDE_vTaskDelayUntil=1
FREERTOS.INCLUDE_vTaskDelete=1
FREERTOS.INCLUDE_vTaskPrioritySet=1
FREERTOS.INCLUDE_vTaskSuspend=1
FREERTOS.INCLUDE_xEventGroupSetBitFromISR=0
FREERTOS.INCLUDE_xQueueGetMutexHolder=0
FREERTOS.INCLUDE_xSemaphoreGetMutexHolder=0
FREERTOS.INCLUDE_xTaskAbortDelay=0
FREERTOS.INCLUDE_xTaskGetCurrentTaskHandle=0
FREERTOS.INCLUDE_xTaskGetHandle=0
FREERTOS.INCLUDE_xTaskGetSchedulerState=1
FREERTOS.INCLUDE_xTaskResumeFromISR=1
FREERTOS.INCLUDE_xTimerPendFunctionCall=0
FREERTOS.MEMORY_ALLOCATION=0
FREERTOS.Tasks01=THREAD1,0,128,LED_Thread1,Default,NULL,Dynamic,NULL,NULL;THREAD2,0,128,LED_Thread2,Default,NULL,Dynamic,NULL,NULL;SIGNAL_GEN,0,128,Signal_Gen_Thread,Default,NULL,Dynamic,NULL,NULL
FREERTOS.configCHECK_FOR_STACK_OVERFLOW=0
FREERTOS.configENABLE_BACKWARD_COMPATIBILITY=0
FREERTOS.configGENERATE_RUN_TIME_STATS=0
FREERTOS.configIDLE_SHOULD_YIELD=1
FREERTOS.configLIBRARY_LOWEST_INTERRUPT_PRIORITY=15
FREERTOS.configLIBRARY_MAX_SYSCALL_INTERRUPT_PRIORITY=5
FREERTOS.configMAX_CO_ROUTINE_PRIORITIES=2
FREERTOS.configMAX_PRIORITIES=8
FREERTOS.configMAX_TASK_NAME_LEN=16
FREERTOS.configMINIMAL_STACK_SIZE=128
FREERTOS.configQUEUE_REGISTRY_SIZE=8
FREERTOS.configRECORD_STACK_HIGH_ADDRESS=0
FREERTOS.configTICK_RATE_HZ=1000
FREERTOS.configTIMER_QUEUE_LENGTH=10
FREERTOS.configTIMER_TASK_PRIORITY=2
FREERTOS.configTIMER_TASK_STACK_DEPTH=256
FREERTOS.configTOTAL_HEAP_SIZE=5120
FREERTOS.configUSE_APPLICATION_TASK_TAG=0
FREERTOS.configUSE_COUNTING_SEMAPHORES=1
FREERTOS.configUSE_CO_ROUTINES=0
FREERTOS.configUSE_DAEMON_TASK_STARTUP_HOOK=0
FREERTOS.configUSE_IDLE_HOOK=0
FREERTOS.configUSE_MALLOC_FAILED_HOOK=0
FREERTOS.configUSE_MUTEXES=1
FREERTOS.configUSE_PREEMPTION=1
FREERTOS.configUSE_RECURSIVE_MUTEXES=1
FREERTOS.configUSE_STATS_FORMATTING_FUNCTIONS=0
FREERTOS.configUSE_TASK_NOTIFICATIONS=1
FREERTOS.configUSE_TICKLESS_IDLE=0
FREERTOS.configUSE_TICK_HOOK=0
FREERTOS.configUSE_TIMERS=1
FREERTOS.configUSE_TRACE_FACILITY=1
Mcu.Family=STM32WB
Mcu.Name=STM32WB55RGVx
Mcu.Package=VFQFPN68
NVIC.PriorityGroup=NVIC_PRIORITYGROUP_4
NVIC.TIM1_TRG_COM_TIM17_IRQn=true\:0\:0\:false\:false\:true\:false\:false\:true
NVIC.TimeBase=TIM1_TRG_COM_TIM17_IRQn
NVIC.TimeBaseIP=TIM17
ProjectManager.HeapSize=0x200
ProjectManager.StackSize=0x400
ProjectManager.TargetToolchain=EWARM V8
RCC.ADCFreq_Value=16000000
RCC.AHB2CLKDivider=RCC_SYSCLK_DIV2
RCC.AHBFreq_Value=64000000
RCC.APB1Freq_Value=64000000
RCC.APB1TimFreq_Value=64000000
RCC.APB2Freq_Value=64000000
RCC.APB2TimFreq_Value=64000000
RCC.APB3Freq_Value=16000000
RCC.CodegenConfigPeriph=false
RCC.CortexFreq_Value=64000000
RCC.HCLKFreq_Value=64000000
RCC.HSE_VALUE=8000000
RCC.HSI48_VALUE=48000000
RCC.HSI_VALUE=16000000
RCC.LSE_VALUE=32768
RCC.MSI_VALUE=4000000
RCC.PLLN=32
RCC.PLLP=RCC_PLLP_DIV5
RCC.PLLQ=4
RCC.SMPSDivider=1
RCC.SYSCLKFreq_VALUE=64000000
RCC.SYSCLKSource=RCC_SYSCLKSOURCE_PLLCLK
RCC.USBFreq_Value=16000000
RCC.VCOOutputFreq_Value=128000000
VP_FREERTOS_VS_CMSIS_V1.Mode=CMSIS_V1
VP_SYS_VS_tim17.Mode=TIM17
board=custom

// file: Src/main.c
/* USER CODE BEGIN Header */
/**
  ******************************************************************************
  * @file    FreeRTOS/FreeRTOS_Signal/Src/main.c
  * @author  MCD Application Team
  * @brief   Main program body
  ******************************************************************************
  * @attention
  *
  * <h2><center>&copy; Copyright (c) 2019 STMicroelectronics International N.V.
  * All rights reserved.</center></h2>
  *
  * Redistribution and use in source and binary forms, with or without
  * modification, are permitted, provided that the following conditions are met:
  *
  * 1. Redistribution of source code must retain the above copyright notice,
  *    this list of conditions and the following disclaimer.
  * 2. Redistributions in binary form must reproduce the above copyright notice,
  *    this list of conditions and the following disclaimer in the documentation
  *    and/or other materials provided with the distribution.
  * 3. Neither the name of STMicroelectronics nor the names of other
  *    contributors to this software may be used to endorse or promote products
  *    derived from this software without specific written permission.
  * 4. This software, including modifications and/or derivative works of this
  *    software, must execute solely and exclusively on microcontroller or
  *    microprocessor devices manufactured by or for STMicroelectronics.
  * 5. Redistribution and use of this software other than as permitted under
  *    this license is void and will automatically terminate your rights under
  *    this license.
  *
  * THIS SOFTWARE IS PROVIDED BY STMICROELECTRONICS AND CONTRIBUTORS "AS IS"
  * AND ANY EXPRESS, IMPLIED OR STATUTORY WARRANTIES, INCLUDING, BUT NOT
  * LIMITED TO, THE IMPLIED WARRANTIES OF MERCHANTABILITY, FITNESS FOR A
  * PARTICULAR PURPOSE AND NON-INFRINGEMENT OF THIRD PARTY INTELLECTUAL PROPERTY
  * RIGHTS ARE DISCLAIMED TO THE FULLEST EXTENT PERMITTED BY LAW. IN NO EVENT
  * SHALL STMICROELECTRONICS OR CONTRIBUTORS BE LIABLE FOR ANY DIRECT, INDIRECT,
  * INCIDENTAL, SPECIAL, EXEMPLARY, OR CONSEQUENTIAL DAMAGES (INCLUDING, BUT NOT
  * LIMITED TO, PROCUREMENT OF SUBSTITUTE GOODS OR SERVICES; LOSS OF USE, DATA,
  * OR PROFITS; OR BUSINESS INTERRUPTION) HOWEVER CAUSED AND ON ANY THEORY OF
  * LIABILITY, WHETHER IN CONTRACT, STRICT LIABILITY, OR TORT (INCLUDING
  * NEGLIGENCE OR OTHERWISE) ARISING IN ANY WAY OUT OF THE USE OF THIS SOFTWARE,
  * EVEN IF ADVISED OF THE POSSIBILITY OF SUCH DAMAGE.
  *
  ******************************************************************************
  */
/* USER CODE END Header */
#include "main.h"
#include "cmsis_os.h"

/* USER CODE BEGIN PD */
   #define BIT_0	( 1 << 0 )
   #define BIT_1	( 1 << 1 )
   #define BIT_2	( 1 << 2 )
/* USER CODE END PD */

osThreadId THREAD1Handle;
osThreadId THREAD2Handle;
osThreadId SIGNAL_GENHandle;

void SystemClock_Config(void);
void LED_Thread1(void const * argument);
void LED_Thread2(void const * argument);
void Signal_Gen_Thread(void const * argument);

int main(void)
{
  /* USER CODE BEGIN 1 */
  /* STM32WBxx HAL library initialization:
       - Configure the Flash prefetch
       - Systick timer is configured by default as source of time base, but user
         can eventually implement his proper time base source (a general purpose
         timer for example or other time source), keeping in mind that Time base
         duration should be kept 1ms since PPP_TIMEOUT_VALUEs are defined and
         handled in milliseconds basis.
       - Set NVIC Group Priority to 4
       - Low Level Initialization
     */
  /* USER CODE END 1 */

  /* MCU Configuration--------------------------------------------------------*/

  /* Reset of all peripherals, Initializes the Flash interface and the Systick. */
  HAL_Init();

  /* Configure the system clock */
  SystemClock_Config();

  /* USER CODE BEGIN SysInit */
  /* Initialize LEDs */
  BSP_LED_Init(LED3);
  BSP_LED_Init(LED2);
  /* USER CODE END SysInit */

  /* Initialize all configured peripherals */

  /* Create the thread(s) */
  /* definition and creation of THREAD1 */
  osThreadDef(THREAD1, LED_Thread1, osPriorityNormal, 0, 128);
  THREAD1Handle = osThreadCreate(osThread(THREAD1), NULL);

  /* definition and creation of THREAD2 */
  osThreadDef(THREAD2, LED_Thread2, osPriorityNormal, 0, 128);
  THREAD2Handle = osThreadCreate(osThread(THREAD2), NULL);

  /* definition and creation of SIGNAL_GEN */
  osThreadDef(SIGNAL_GEN, Signal_Gen_Thread, osPriorityNormal, 0, 128);
  SIGNAL_GENHandle = osThreadCreate(osThread(SIGNAL_GEN), NULL);

  /* Start scheduler */
  osKernelStart();

  /* We should never get here as control is now taken by the scheduler */
  /* Infinite loop */
  while (1)
  {

  }
}

void SystemClock_Config(void)
{
  RCC_OscInitTypeDef RCC_OscInitStruct = {0};
  RCC_ClkInitTypeDef RCC_ClkInitStruct = {0};

  /** Initializes the RCC Oscillators according to the specified parameters
  * in the RCC_OscInitTypeDef structure.
  */
  RCC_OscInitStruct.OscillatorType = RCC_OSCILLATORTYPE_MSI;
  RCC_OscInitStruct.MSIState = RCC_MSI_ON;
  RCC_OscInitStruct.MSICalibrationValue = RCC_MSICALIBRATION_DEFAULT;
  RCC_OscInitStruct.MSIClockRange = RCC_MSIRANGE_6;
  RCC_OscInitStruct.PLL.PLLState = RCC_PLL_ON;
  RCC_OscInitStruct.PLL.PLLSource = RCC_PLLSOURCE_MSI;
  RCC_OscInitStruct.PLL.PLLM = RCC_PLLM_DIV1;
  RCC_OscInitStruct.PLL.PLLN = 32;
  RCC_OscInitStruct.PLL.PLLP = RCC_PLLP_DIV5;
  RCC_OscInitStruct.PLL.PLLR = RCC_PLLR_DIV2;
  RCC_OscInitStruct.PLL.PLLQ = 4;
  if (HAL_RCC_OscConfig(&RCC_OscInitStruct) != HAL_OK)
  {
    Error_Handler();
  }
  /** Configure the SYSCLKSource, HCLK, PCLK1 and PCLK2 clocks dividers
  */
  RCC_ClkInitStruct.ClockType = RCC_CLOCKTYPE_HCLK4|RCC_CLOCKTYPE_HCLK2
                              |RCC_CLOCKTYPE_HCLK|RCC_CLOCKTYPE_SYSCLK
                              |RCC_CLOCKTYPE_PCLK1|RCC_CLOCKTYPE_PCLK2;
  RCC_ClkInitStruct.SYSCLKSource = RCC_SYSCLKSOURCE_PLLCLK;
  RCC_ClkInitStruct.AHBCLKDivider = RCC_SYSCLK_DIV1;
  RCC_ClkInitStruct.APB1CLKDivider = RCC_HCLK_DIV1;
  RCC_ClkInitStruct.APB2CLKDivider = RCC_HCLK_DIV1;
  RCC_ClkInitStruct.AHBCLK2Divider = RCC_SYSCLK_DIV2;
  RCC_ClkInitStruct.AHBCLK4Divider = RCC_SYSCLK_DIV1;

  if (HAL_RCC_ClockConfig(&RCC_ClkInitStruct, FLASH_LATENCY_3) != HAL_OK)
  {
    Error_Handler();
  }
  /** Initializes the peripherals clocks
  */
}

void LED_Thread1(void const * argument)
{
  /* USER CODE BEGIN 5 */
  (void) argument;
  osEvent event;
  /* Infinite loop */
  for(;;)
  {
    event = osSignalWait( BIT_0, osWaitForever);
    if(event.value.signals == BIT_0)
    {
      BSP_LED_Toggle(LED3);
    }
  }
  /* USER CODE END 5 */
}

void LED_Thread2(void const * argument)
{
  /* USER CODE BEGIN LED_Thread2 */
  (void) argument;
  osEvent event;
  /* Infinite loop */
  for(;;)
  {
    event = osSignalWait( BIT_1 | BIT_2, osWaitForever);
    if(event.value.signals == (BIT_1 | BIT_2))
    {
     BSP_LED_Toggle(LED2);
    }
  }
  /* USER CODE END LED_Thread2 */
}

void Signal_Gen_Thread(void const * argument)
{
  /* USER CODE BEGIN Signal_Gen_Thread */
  (void) argument;
  /* Infinite loop */
  for(;;)
  {
    osSignalSet(THREAD1Handle, BIT_0 );
    osDelay(500);
    osSignalSet(THREAD2Handle, BIT_1 | BIT_2 );
    osDelay(500);
  }
  /* USER CODE END Signal_Gen_Thread */
}

 /**
  * @brief  Period elapsed callback in non blocking mode
  * @note   This function is called  when TIM17 interrupt took place, inside
  * HAL_TIM_IRQHandler(). It makes a direct call to HAL_IncTick() to increment
  * a global variable "uwTick" used as application time base.
  * @param  htim : TIM handle
  * @retval None
  */
void HAL_TIM_PeriodElapsedCallback(TIM_HandleTypeDef *htim)
{
  if (htim->Instance == TIM17) {
    HAL_IncTick();
  }
}

void Error_Handler(void)
{
}

#ifdef  USE_FULL_ASSERT
/**
  * @brief  Reports the name of the source file and the source line number
  *         where the assert_param error has occurred.
  * @param  file: pointer to the source file name
  * @param  line: assert_param error line source number
  * @retval None
  */
void assert_failed(uint8_t *file, uint32_t line)
{
  /* USER CODE BEGIN 6 */
  /* User can add his own implementation to report the file name and line number,
     tex: printf("Wrong parameters value: file %s on line %d\r\n", file, line) */

  /* Infinite loop */
  while (1)
  {}
  /* USER CODE END 6 */
}
#endif /* USE_FULL_ASSERT */

/************************ (C) COPYRIGHT STMicroelectronics *****END OF FILE****/
